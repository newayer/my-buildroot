## vendor/package/python-ioctl-opt/Config.in
```kconfig
config BR2_PACKAGE_PYTHON_IOCTL_OPT
	bool "python-ioctl-opt"
	help
	  Functions to compute fnctl.ioctl's opt argument

	  http://github.com/vpelletier/python-ioctl-opt
```

## vendor/package/python-pynmeagps/Config.in
```kconfig
config BR2_PACKAGE_PYTHON_PYNMEAGPS
	bool "python-pynmeagps"
	help
	  NMEA protocol parser and generator.

	  https://github.com/semuconsulting/pynmeagps
```

## vendor/package/python-pythoncrc/Config.in
```kconfig
config BR2_PACKAGE_PYTHON_PYTHONCRC
	bool "python-pythoncrc"
	help
	  Python libraries for CRC calculations (it supports CRC-16, CRC-32, CRC-CCITT, etc)

	   https://pycrc.readthedocs.org
```

## vendor/package/python-quart/Config.in
```kconfig
config BR2_PACKAGE_PYTHON_QUART
	bool "python-quart"
	select BR2_PACKAGE_PYTHON_FLASK # runtime
	help
	  Quart is an async Python web application framework.

	  https://github.com/pallets/quart
```

## vendor/package/python-serial-packets/Config.in
```kconfig
config BR2_PACKAGE_PYTHON_SERIAL_PACKETS
	bool "python-serial-packets"
	select BR2_PACKAGE_PYTHON_SERIAL_ASYNCIO # runtime
	select BR2_PACKAGE_PYTHON_PYTHONCRC # runtime
	help
	  A Python impelementation of the Serial Packets protocol.

	  https://github.com/zapta/serial_packets_py
```

## vendor/package/python-statemachine/Config.in
```kconfig
config BR2_PACKAGE_PYTHON_STATEMACHINE
	bool "python-statemachine"
	help
	  Python StateMachine.

	  https://github.com/fgmacedo/python-statemachine
```

## vendor/package/rockchip/Config.in
```kconfig
source "$BR2_EXTERNAL_NEWAYER_PATH/package/rockchip/kmpp/Config.in"
source "$BR2_EXTERNAL_NEWAYER_PATH/package/rockchip/rkbin/Config.in"
source "$BR2_EXTERNAL_NEWAYER_PATH/package/rockchip/rockit/Config.in"
source "$BR2_EXTERNAL_NEWAYER_PATH/package/rockchip/aic8800dc/Config.in"
```

## vendor/package/rockchip/aic8800dc/Config.in
```kconfig
config BR2_PACKAGE_AIC8800DC
	bool "kernel-module-aic8800dc"
	depends on BR2_LINUX_KERNEL
	help
	  rk3506 demo wifi kernel module.
```

## vendor/package/rockchip/kmpp/Config.in
```kconfig
config BR2_PACKAGE_KMPP
	bool "kernel-module-kmpp"
	depends on BR2_LINUX_KERNEL
	help
	  rv1106 mpp kernel module.
```

## vendor/package/rockchip/rkbin/Config.in
```kconfig
config BR2_PACKAGE_RKBIN
        bool "rkbin"
        help
          Rockchip binary blobs

if BR2_PACKAGE_RKBIN

comment "rkbin package Parameters"

config BR2_PACKAGE_RKBIN_VERSION
	string "Custom git repository version"
	default "br_rk3506"
	help
	  Revision to use in the typical format used by
	  Git E.G. a sha id, a tag

endif # BR2_PACKAGE_RKBIN
```

## vendor/package/rockchip/rockit/Config.in
```kconfig
config BR2_PACKAGE_ROCKIT
	bool "kernel-module-rockit"
	depends on BR2_LINUX_KERNEL
	help
	  rv1106 rockit kernel module.
```
