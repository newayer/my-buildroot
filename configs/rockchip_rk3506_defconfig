## configs/rockchip_rk3588_ipc_defconfig
```kconfig
#include "rockchip_rk3588_defconfig"
#include "gpu/gpu.config"
#include "multimedia/audio.config"
#include "multimedia/camera.config"
#include "multimedia/mpp.config"
#include "products/ipc.config"
#include "npu2.config"
# BR2_PACKAGE_WAYLAND is not set
# BR2_PACKAGE_WESTON is not set
BR2_PACKAGE_CAMERA_ENGINE_RKAIQ
BR2_PACKAGE_CAMERA_ENGINE_RKAIQ_INSTALL_AIISP=y
BR2_PACKAGE_IVA=y
BR2_PACKAGE_IVA_RK3588=y
BR2_PACKAGE_RKIPC=y
BR2_PACKAGE_SAMPLES=y
BR2_ROOTFS_OVERLAY="board/rockchip/common/base board/rockchip/rk3588/fs-overlay-ipc/"
```

## configs/rockchip_rk3588_multi_ipc_defconfig
```kconfig
#include "rockchip_rk3588_ipc_defconfig"
BR2_PACKAGE_AVS=y
BR2_PACKAGE_RKIPC_RK3588_MULTI_IPC=y
```

## vendor/configs/luckfox_pico_ultra_w_paver_defconfig
```kconfig
BR2_arm=y
BR2_cortex_a7=y
BR2_TOOLCHAIN_EXTERNAL=y
BR2_TOOLCHAIN_EXTERNAL_CUSTOM=y
BR2_TOOLCHAIN_EXTERNAL_DOWNLOAD=y
BR2_TOOLCHAIN_EXTERNAL_URL="file://$(BR2_EXTERNAL_NEWAYER_PATH)/tools/toolchain/arm-rockchip830-linux-uclibcgnueabihf.tar.xz"
BR2_TOOLCHAIN_EXTERNAL_CUSTOM_PREFIX="arm-rockchip830-linux-uclibcgnueabihf"
BR2_TOOLCHAIN_EXTERNAL_GCC_8=y
BR2_TOOLCHAIN_EXTERNAL_HEADERS_5_10=y
BR2_TOOLCHAIN_EXTERNAL_WCHAR=y
BR2_TOOLCHAIN_EXTERNAL_HAS_SSP=y
BR2_TOOLCHAIN_EXTERNAL_CXX=y
BR2_DL_DIR="$(TOPDIR)/../my-buildroot-dl"
BR2_PRIMARY_SITE="http://sources.buildroot.net"
BR2_OPTIMIZE_3=y
BR2_PACKAGE_OVERRIDE_FILE="vendor/board/newayer/luckfox-pico/luckfox-pico.mk"
BR2_TARGET_GENERIC_HOSTNAME="iot101"
BR2_TARGET_GENERIC_ISSUE="Welcome to iot gateway"
BR2_ROOTFS_DEVICE_CREATION_DYNAMIC_EUDEV=y
BR2_TARGET_GENERIC_ROOT_PASSWD="Xt1234%"
BR2_SYSTEM_BIN_SH_BASH=y
BR2_SYSTEM_DHCP="wlan0"
BR2_ROOTFS_OVERLAY="vendor/board/newayer/common/rootfs_overlay vendor/board/newayer/luckfox-pico/ultra/rootfs_overlay vendor/board/newayer/luckfox-pico/ultra-w/rootfs_overlay"
BR2_ROOTFS_POST_BUILD_SCRIPT="vendor/board/newayer/common/post-build.sh"
BR2_ROOTFS_POST_IMAGE_SCRIPT="vendor/board/newayer/luckfox-pico/post-images-ultra.sh"
BR2_LINUX_KERNEL=y
BR2_LINUX_KERNEL_CUSTOM_GIT=y
BR2_LINUX_KERNEL_CUSTOM_REPO_URL="git@github.com:newayer/my-kernel.git"
BR2_LINUX_KERNEL_CUSTOM_REPO_VERSION="br_luckfox"
BR2_LINUX_KERNEL_DEFCONFIG="luckfox_rv1106_linux"
BR2_LINUX_KERNEL_CONFIG_FRAGMENT_FILES="$(LINUX_DIR)/arch/arm/configs/rv1106-bt.config"
BR2_LINUX_KERNEL_IMAGE_TARGET_CUSTOM=y
BR2_LINUX_KERNEL_IMAGE_TARGET_NAME="rv1106g-luckfox-pico-ultra-w-paver.img BOOT_ITS=boot.its"
BR2_LINUX_KERNEL_IMAGE_NAME="zImage"
BR2_LINUX_KERNEL_DTS_SUPPORT=y
BR2_LINUX_KERNEL_INTREE_DTS_NAME="rv1106g-luckfox-pico-ultra-w-paver"
BR2_LINUX_KERNEL_DTB_OVERLAY_SUPPORT=y
BR2_PACKAGE_BUSYBOX_SHOW_OTHERS=y
BR2_PACKAGE_BZIP2=y
BR2_PACKAGE_STRACE=y
BR2_PACKAGE_STRESS=y
BR2_PACKAGE_E2FSPROGS=y
BR2_PACKAGE_E2FSPROGS_RESIZE2FS=y
BR2_PACKAGE_EUDEV_RULES_GEN=y
BR2_PACKAGE_MEMTESTER=y
BR2_PACKAGE_MINICOM=y
BR2_PACKAGE_NANOCOM=y
BR2_PACKAGE_SYSSTAT=y
BR2_PACKAGE_ARGPARSE=y
BR2_PACKAGE_COPAS=y
BR2_PACKAGE_COXPCALL=y
BR2_PACKAGE_LSQLITE3=y
BR2_PACKAGE_LUA_CJSON=y
BR2_PACKAGE_LUA_COMPAT53=y
BR2_PACKAGE_LUA_CURL=y
BR2_PACKAGE_LUA_PERIPHERY=y
BR2_PACKAGE_LUALOGGING=y
BR2_PACKAGE_LUAOSSL=y
BR2_PACKAGE_LUASEC=y
BR2_PACKAGE_LUV=y
BR2_PACKAGE_PYTHON3=y
BR2_PACKAGE_PYTHON_AIOFILES=y
BR2_PACKAGE_PYTHON_AIOHTTP=y
BR2_PACKAGE_PYTHON_COLORLOG=y
BR2_PACKAGE_PYTHON_PERIPHERY=y
BR2_PACKAGE_PYTHON_PILLOW=y
BR2_PACKAGE_PYTHON_PSUTIL=y
BR2_PACKAGE_PYTHON_SMBUS_CFFI=y
BR2_PACKAGE_PYTHON_SPIDEV=y
BR2_PACKAGE_PYTHON_WEBSOCKETS=y
BR2_PACKAGE_GNUTLS=y
BR2_PACKAGE_LIBMD=y
BR2_PACKAGE_GIFLIB=y
BR2_PACKAGE_JPEG=y
BR2_PACKAGE_LIBPNG=y
BR2_PACKAGE_C_PERIPHERY=y
BR2_PACKAGE_DTC=y
BR2_PACKAGE_DTC_PROGRAMS=y
BR2_PACKAGE_LIBV4L=y
BR2_PACKAGE_LIBV4L_UTILS=y
BR2_PACKAGE_CJSON=y
BR2_PACKAGE_CJSON_UTILS=y
BR2_PACKAGE_SPDLOG=y
BR2_PACKAGE_ZLOG=y
BR2_PACKAGE_LIBCURL_CURL=y
BR2_PACKAGE_LIBMICROHTTPD=y
BR2_PACKAGE_LIBWEBSOCKETS=y
BR2_PACKAGE_PCRE_32=y
BR2_PACKAGE_BRIDGE_UTILS=y
BR2_PACKAGE_CAN_UTILS=y
BR2_PACKAGE_IPERF=y
BR2_PACKAGE_IPERF3=y
BR2_PACKAGE_IPROUTE2=y
BR2_PACKAGE_IPTABLES=y
BR2_PACKAGE_IPUTILS=y
BR2_PACKAGE_IW=y
BR2_PACKAGE_LRZSZ=y
BR2_PACKAGE_NTP=y
BR2_PACKAGE_OPENSSH=y
BR2_PACKAGE_SOCAT=y
BR2_PACKAGE_SSHPASS=y
BR2_PACKAGE_TCPDUMP=y
BR2_PACKAGE_WGET=y
BR2_PACKAGE_WIRELESS_REGDB=y
BR2_PACKAGE_WIRELESS_TOOLS=y
BR2_PACKAGE_WIRELESS_TOOLS_LIB=y
BR2_PACKAGE_WPA_SUPPLICANT=y
BR2_PACKAGE_WPA_SUPPLICANT_AUTOSCAN=y
BR2_PACKAGE_WPA_SUPPLICANT_EAP=y
BR2_PACKAGE_WPA_SUPPLICANT_DEBUG_SYSLOG=y
BR2_PACKAGE_WPA_SUPPLICANT_CLI=y
BR2_PACKAGE_WPA_SUPPLICANT_WPA_CLIENT_SO=y
BR2_PACKAGE_WPA_SUPPLICANT_PASSPHRASE=y
BR2_PACKAGE_WPA_SUPPLICANT_DBUS=y
BR2_PACKAGE_BASH_COMPLETION=y
BR2_PACKAGE_DIALOG=y
BR2_PACKAGE_TIME=y
BR2_PACKAGE_ANDROID_TOOLS=y
BR2_PACKAGE_ANDROID_TOOLS_FASTBOOT=y
BR2_PACKAGE_ANDROID_TOOLS_ADB=y
BR2_PACKAGE_ANDROID_TOOLS_ADBD=y
BR2_PACKAGE_HTOP=y
BR2_PACKAGE_TAR=y
BR2_PACKAGE_UTIL_LINUX_LIBFDISK=y
BR2_PACKAGE_UTIL_LINUX_LIBMOUNT=y
BR2_PACKAGE_UTIL_LINUX_HWCLOCK=y
BR2_PACKAGE_NANO=y
BR2_TARGET_ROOTFS_EXT2=y
BR2_TARGET_ROOTFS_EXT2_4=y
BR2_TARGET_ROOTFS_EXT2_SIZE="768M"
BR2_TARGET_ROOTFS_EXT2_MKFS_OPTIONS="-O ^64bit,^huge_file"
# BR2_TARGET_ROOTFS_TAR is not set
BR2_TARGET_UBOOT=y
BR2_TARGET_UBOOT_BUILD_SYSTEM_KCONFIG=y
BR2_TARGET_UBOOT_CUSTOM_GIT=y
BR2_TARGET_UBOOT_CUSTOM_REPO_URL="git@github.com:newayer/my-uboot.git"
BR2_TARGET_UBOOT_CUSTOM_REPO_VERSION="br_luckfox"
BR2_TARGET_UBOOT_BOARD_DEFCONFIG="luckfox_rv1106_uboot"
BR2_TARGET_UBOOT_CONFIG_FRAGMENT_FILES="$(UBOOT_DIR)/configs/rk-emmc.config"
BR2_TARGET_UBOOT_NEEDS_DTC=y
BR2_TARGET_UBOOT_NEEDS_PYLIBFDT=y
# BR2_TARGET_UBOOT_FORMAT_BIN is not set
BR2_TARGET_UBOOT_FORMAT_CUSTOM=y
BR2_TARGET_UBOOT_FORMAT_CUSTOM_NAME="uboot.img"
BR2_TARGET_UBOOT_RK=y
BR2_TARGET_UBOOT_RK_ENV_SIZE=0x8000
BR2_TARGET_UBOOT_RK_ENV_FILE="$(BR2_EXTERNAL)/board/newayer/luckfox-pico/env_ultra.txt"
BR2_PACKAGE_HOST_CRAMFS=y
BR2_PACKAGE_HOST_DOSFSTOOLS=y
BR2_PACKAGE_HOST_EROFS_UTILS=y
BR2_PACKAGE_HOST_GENIMAGE=y
BR2_PACKAGE_HOST_SQUASHFS=y
BR2_PACKAGE_HOST_SWIG=y
BR2_PACKAGE_HOST_UBOOT_TOOLS=y
BR2_PACKAGE_HOST_UBOOT_TOOLS_FIT_SUPPORT=y
BR2_PACKAGE_HOST_UBOOT_TOOLS_FIT_SIGNATURE_SUPPORT=y
BR2_PACKAGE_LUA_MOSQUITTO=y
BR2_PACKAGE_LUAMQTT=y
BR2_PACKAGE_OPENRESTY=y
BR2_PACKAGE_OPENRESTY_SELECT_MODULE=y
BR2_PACKAGE_OPENRESTY_POLL_MODULE=y
BR2_PACKAGE_OPENRESTY_LUAJIT=y
BR2_PACKAGE_OPENRESTY_LUAJIT_COMPAT52=y
BR2_PACKAGE_PYTHON_AIOMQTT=y
BR2_PACKAGE_PYTHON_IOCTL_OPT=y
BR2_PACKAGE_PYTHON_QUART=y
BR2_PACKAGE_PYTHON_SERIAL_PACKETS=y
BR2_PACKAGE_RKBIN=y
BR2_PACKAGE_AIC8800DC=y
BR2_PACKAGE_WORKSITE_D=y
BR2_PACKAGE_WORKSITE_D_URL="git@github.com:newayer/worksite-d.git"
BR2_PACKAGE_WORKSITE_D_VERSION="v1.0.1"
BR2_PACKAGE_WORKSITE_D_PAVER=y
BR2_PACKAGE_INIT_SCRIPTS=y
BR2_PACKAGE_INIT_SCRIPT_TIME=y
BR2_PACKAGE_INIT_SCRIPT_MOUNT=y
BR2_PACKAGE_INIT_SCRIPT_DAEMON_WIFI=y
BR2_PACKAGE_INIT_SCRIPT_ADB=y
BR2_PACKAGE_INIT_SCRIPT_ETH=y
```

## vendor/configs/rockchip_rk3506-rtk_defconfig
```kconfig
BR2_arm=y
BR2_cortex_a7=y
BR2_TOOLCHAIN_EXTERNAL=y
BR2_TOOLCHAIN_EXTERNAL_CUSTOM=y
BR2_TOOLCHAIN_EXTERNAL_PATH="/opt/toolchain-buildroot"
BR2_TOOLCHAIN_EXTERNAL_GCC_12=y
BR2_TOOLCHAIN_EXTERNAL_HEADERS_6_1=y
BR2_TOOLCHAIN_EXTERNAL_CUSTOM_GLIBC=y
# BR2_TOOLCHAIN_EXTERNAL_INET_RPC is not set
BR2_TOOLCHAIN_EXTERNAL_CXX=y
BR2_DL_DIR="$(TOPDIR)/../my-buildroot-dl"
BR2_PRIMARY_SITE="https://sources.buildroot.net"
BR2_BACKUP_SITE=""
BR2_GNU_MIRROR="https://mirrors.ustc.edu.cn/gnu"
BR2_OPTIMIZE_3=y
BR2_PACKAGE_OVERRIDE_FILE="vendor/board/newayer/rk3506/rtk.mk"
BR2_FORCE_HOST_BUILD=y
BR2_TIME_BITS_64=y
BR2_TARGET_GENERIC_HOSTNAME="rtk"
BR2_TARGET_GENERIC_ISSUE="Welcome to rtk"
BR2_ROOTFS_DEVICE_CREATION_DYNAMIC_EUDEV=y
BR2_ROOTFS_MERGED_USR=y
BR2_TARGET_GENERIC_ROOT_PASSWD="Xt1234%"
BR2_TARGET_SERIAL_SHELL_GETTY=y
# BR2_TARGET_GENERIC_REMOUNT_ROOTFS_RW is not set
BR2_SYSTEM_DHCP="wlan0"
BR2_ROOTFS_OVERLAY="vendor/board/newayer/common/rootfs_overlay vendor/board/newayer/rk3506/rtk/rootfs_overlay"
BR2_ROOTFS_POST_BUILD_SCRIPT="vendor/board/newayer/common/post-build.sh"
BR2_ROOTFS_POST_IMAGE_SCRIPT="vendor/board/newayer/rk3506/post-images-nand.sh"
BR2_LINUX_KERNEL=y
BR2_LINUX_KERNEL_CUSTOM_GIT=y
BR2_LINUX_KERNEL_CUSTOM_REPO_URL="git@github.com:newayer/my-kernel.git"
BR2_LINUX_KERNEL_CUSTOM_REPO_VERSION="br_rk3506"
BR2_LINUX_KERNEL_DEFCONFIG="rk3506_my"
BR2_LINUX_KERNEL_CONFIG_FRAGMENT_FILES="$(LINUX_DIR)/arch/arm/configs/rk3506-usb-otg.config $(LINUX_DIR)/arch/arm/configs/rk3506-my-rtk.config"
BR2_LINUX_KERNEL_IMAGE_TARGET_CUSTOM=y
BR2_LINUX_KERNEL_IMAGE_TARGET_NAME="rk3506g-my-rtk.img BOOT_ITS=boot.its"
BR2_LINUX_KERNEL_IMAGE_NAME="zImage"
BR2_LINUX_KERNEL_DTS_SUPPORT=y
BR2_LINUX_KERNEL_DTB_IS_SELF_BUILT=y
BR2_LINUX_KERNEL_INTREE_DTS_NAME="rk3506g-my-rtk"
BR2_PACKAGE_LINUX_TOOLS_GPIO=y
BR2_PACKAGE_ROCKCHIP=y
BR2_PACKAGE_RK3506=y
BR2_PACKAGE_BUSYBOX_CONFIG_FRAGMENT_FILES="board/rockchip/common/base/busybox.fragment"
BR2_PACKAGE_BUSYBOX_SHOW_OTHERS=y
BR2_PACKAGE_DOSFSTOOLS=y
BR2_PACKAGE_DOSFSTOOLS_FATLABEL=y
BR2_PACKAGE_DOSFSTOOLS_FSCK_FAT=y
BR2_PACKAGE_DOSFSTOOLS_MKFS_FAT=y
BR2_PACKAGE_E2FSPROGS=y
BR2_PACKAGE_E2FSPROGS_RESIZE2FS=y
BR2_PACKAGE_FATRESIZE=y
BR2_PACKAGE_MTD=y
BR2_PACKAGE_EUDEV_RULES_GEN=y
BR2_PACKAGE_EVTEST=y
BR2_PACKAGE_I2C_TOOLS=y
BR2_PACKAGE_INPUT_EVENT_DAEMON=y
BR2_PACKAGE_MEMTESTER=y
BR2_PACKAGE_MHZ=y
BR2_PACKAGE_MINICOM=y
BR2_PACKAGE_NANOCOM=y
BR2_PACKAGE_PM_UTILS=y
BR2_PACKAGE_SYSSTAT=y
BR2_PACKAGE_USBMOUNT=y
BR2_PACKAGE_PYTHON3=y
BR2_PACKAGE_PYTHON_AIOFILES=y
BR2_PACKAGE_PYTHON_AIOHTTP=y
BR2_PACKAGE_PYTHON_AIOSQLITE=y
BR2_PACKAGE_PYTHON_COLORLOG=y
BR2_PACKAGE_PYTHON_PERIPHERY=y
BR2_PACKAGE_PYTHON_PILLOW=y
BR2_PACKAGE_PYTHON_PIP=y
BR2_PACKAGE_PYTHON_PSUTIL=y
BR2_PACKAGE_PYTHON_SMBUS_CFFI=y
BR2_PACKAGE_PYTHON_SPIDEV=y
BR2_PACKAGE_PYTHON_WEBSOCKETS=y
BR2_PACKAGE_GNUTLS=y
BR2_PACKAGE_LIBOPENSSL_BIN=y
BR2_PACKAGE_C_PERIPHERY=y
BR2_PACKAGE_DTC=y
BR2_PACKAGE_DTC_PROGRAMS=y
BR2_PACKAGE_LIBGPIOD=y
BR2_PACKAGE_LIBGPIOD_TOOLS=y
BR2_PACKAGE_CJSON=y
BR2_PACKAGE_CJSON_UTILS=y
BR2_PACKAGE_LIBWEBSOCKETS=y
BR2_PACKAGE_LIBCAP=y
BR2_PACKAGE_LIBEVDEV=y
BR2_PACKAGE_GESFTPSERVER=y
BR2_PACKAGE_HOSTAPD=y
BR2_PACKAGE_IPERF3=y
BR2_PACKAGE_IPROUTE2=y
BR2_PACKAGE_IPTABLES=y
BR2_PACKAGE_IPTABLES_BPF_NFSYNPROXY=y
BR2_PACKAGE_IPTABLES_NFTABLES=y
BR2_PACKAGE_IPUTILS=y
BR2_PACKAGE_IW=y
BR2_PACKAGE_LRZSZ=y
BR2_PACKAGE_OPENSSH=y
BR2_PACKAGE_OPENSSH_GEN_KEYS=y
BR2_PACKAGE_OPENVPN=y
BR2_PACKAGE_PHYTOOL=y
BR2_PACKAGE_SOCAT=y
BR2_PACKAGE_TCPDUMP=y
BR2_PACKAGE_WGET=y
BR2_PACKAGE_WIRELESS_REGDB=y
BR2_PACKAGE_WIRELESS_TOOLS=y
BR2_PACKAGE_WIRELESS_TOOLS_LIB=y
BR2_PACKAGE_WPA_SUPPLICANT=y
BR2_PACKAGE_WPA_SUPPLICANT_AUTOSCAN=y
BR2_PACKAGE_WPA_SUPPLICANT_EAP=y
BR2_PACKAGE_WPA_SUPPLICANT_PASSPHRASE=y
BR2_PACKAGE_WPA_SUPPLICANT_DBUS=y
BR2_PACKAGE_BASH_COMPLETION=y
BR2_PACKAGE_DIALOG=y
BR2_PACKAGE_TIME=y
BR2_PACKAGE_ANDROID_TOOLS=y
BR2_PACKAGE_ANDROID_TOOLS_FASTBOOT=y
BR2_PACKAGE_ANDROID_TOOLS_ADB=y
BR2_PACKAGE_ANDROID_TOOLS_ADBD=y
BR2_PACKAGE_HTOP=y
BR2_PACKAGE_TAR=y
BR2_PACKAGE_UTIL_LINUX_LIBFDISK=y
BR2_PACKAGE_UTIL_LINUX_AGETTY=y
BR2_PACKAGE_UTIL_LINUX_HWCLOCK=y
BR2_PACKAGE_UTIL_LINUX_MOUNT=y
BR2_PACKAGE_VIM=y
BR2_TARGET_ROOTFS_UBI=y
BR2_TARGET_ROOTFS_UBI_SUBSIZE=2048
BR2_TARGET_ROOTFS_UBI_OPTS="-v"
BR2_TARGET_ROOTFS_UBIFS_LEBSIZE=0x1f000
BR2_TARGET_ROOTFS_UBIFS_MAX_SIZE=1024
BR2_TARGET_ROOTFS_UBIFS_OPTS="-F -v"
BR2_TARGET_UBOOT=y
BR2_TARGET_UBOOT_BUILD_SYSTEM_KCONFIG=y
BR2_TARGET_UBOOT_CUSTOM_GIT=y
BR2_TARGET_UBOOT_CUSTOM_REPO_URL="git@github.com:newayer/my-uboot.git"
BR2_TARGET_UBOOT_CUSTOM_REPO_VERSION="br_my_rk3506"
BR2_TARGET_UBOOT_BOARD_DEFCONFIG="rk3506"
BR2_TARGET_UBOOT_CONFIG_FRAGMENT_FILES="$(UBOOT_DIR)/configs/rk3506b.config $(UBOOT_DIR)/configs/rk3506_tb.config"
BR2_TARGET_UBOOT_NEEDS_DTC=y
BR2_TARGET_UBOOT_NEEDS_PYLIBFDT=y
# BR2_TARGET_UBOOT_FORMAT_BIN is not set
BR2_TARGET_UBOOT_FORMAT_CUSTOM=y
BR2_TARGET_UBOOT_FORMAT_CUSTOM_NAME="uboot.img"
BR2_TARGET_UBOOT_RK=y
BR2_PACKAGE_HOST_CRAMFS=y
BR2_PACKAGE_HOST_DOSFSTOOLS=y
BR2_PACKAGE_HOST_E2FSPROGS=y
BR2_PACKAGE_HOST_ENVIRONMENT_SETUP=y
BR2_PACKAGE_HOST_EROFS_UTILS=y
BR2_PACKAGE_HOST_GENIMAGE=y
BR2_PACKAGE_HOST_NTFS_3G=y
BR2_PACKAGE_HOST_PYTHON3=y
BR2_PACKAGE_HOST_PYTHON3_SSL=y
BR2_PACKAGE_HOST_SQUASHFS=y
BR2_PACKAGE_HOST_SWIG=y
BR2_PACKAGE_HOST_UBOOT_TOOLS=y
BR2_PACKAGE_HOST_UBOOT_TOOLS_FIT_SUPPORT=y
BR2_PACKAGE_HOST_UBOOT_TOOLS_FIT_SIGNATURE_SUPPORT=y
BR2_PACKAGE_PYTHON_AIOMQTT=y
BR2_PACKAGE_PYTHON_IOCTL_OPT=y
BR2_PACKAGE_PYTHON_PYNMEAGPS=y
BR2_PACKAGE_PYTHON_QUART=y
BR2_PACKAGE_PYTHON_SERIAL_PACKETS=y
BR2_PACKAGE_PYTHON_STATEMACHINE=y
BR2_PACKAGE_RKBIN=y
BR2_PACKAGE_AIC8800DC=y
BR2_PACKAGE_WORKSITE_D=y
BR2_PACKAGE_WORKSITE_D_URL="git@github.com:newayer/worksite-d.git"
BR2_PACKAGE_WORKSITE_D_VERSION="v1.0.1"
BR2_PACKAGE_WORKSITE_D_RTK=y
BR2_PACKAGE_INIT_SCRIPTS=y
BR2_PACKAGE_INIT_SCRIPT_MOUNT=y
BR2_PACKAGE_INIT_SCRIPT_MOUNT_NAND=y
BR2_PACKAGE_INIT_SCRIPT_LINK_RK3506=y
BR2_PACKAGE_INIT_SCRIPT_TIME=y
BR2_PACKAGE_INIT_SCRIPT_DAEMON_WIFI=y
BR2_PACKAGE_INIT_SCRIPT_ADB=y
```
