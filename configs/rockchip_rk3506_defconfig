## vendor/configs/rockchip_rk3506_vanxoak-sat_defconfig
```kconfig
BR2_arm=y
BR2_cortex_a7=y
BR2_TOOLCHAIN_EXTERNAL=y
BR2_TOOLCHAIN_EXTERNAL_CUSTOM=y
BR2_TOOLCHAIN_EXTERNAL_PATH="/opt/toolchain-buildroot"
BR2_TOOLCHAIN_EXTERNAL_GCC_12=y
BR2_TOOLCHAIN_EXTERNAL_HEADERS_6_1=y
BR2_TOOLCHAIN_EXTERNAL_CUSTOM_GLIBC=y
# BR2_TOOLCHAIN_EXTERNAL_INET_RPC is not set
BR2_TOOLCHAIN_EXTERNAL_CXX=y
BR2_DL_DIR="$(TOPDIR)/../my-buildroot-dl"
BR2_PRIMARY_SITE="https://sources.buildroot.net"
BR2_BACKUP_SITE=""
BR2_GNU_MIRROR="https://mirrors.ustc.edu.cn/gnu"
BR2_OPTIMIZE_3=y
BR2_PACKAGE_OVERRIDE_FILE="vendor/board/newayer/rk3506/vanxoak-sat.mk"
BR2_FORCE_HOST_BUILD=y
BR2_TIME_BITS_64=y
BR2_TARGET_GENERIC_HOSTNAME="sat"
BR2_TARGET_GENERIC_ISSUE="Welcome to sat"
BR2_ROOTFS_DEVICE_CREATION_DYNAMIC_EUDEV=y
BR2_ROOTFS_MERGED_USR=y
BR2_TARGET_GENERIC_ROOT_PASSWD="Dn1234%"
BR2_TARGET_SERIAL_SHELL_GETTY=y
BR2_ROOTFS_OVERLAY="vendor/board/newayer/common/rootfs_overlay vendor/board/newayer/rk3506/vanxoak-sat/rootfs_overlay"
BR2_ROOTFS_POST_BUILD_SCRIPT="vendor/board/newayer/common/post-build.sh"
BR2_ROOTFS_POST_IMAGE_SCRIPT="vendor/board/newayer/rk3506/post-images-emmc.sh"
BR2_LINUX_KERNEL=y
BR2_LINUX_KERNEL_CUSTOM_GIT=y
BR2_LINUX_KERNEL_CUSTOM_REPO_URL="git@github.com:newayer/my-kernel.git"
BR2_LINUX_KERNEL_CUSTOM_REPO_VERSION="br_rk3506"
BR2_LINUX_KERNEL_DEFCONFIG="rk3506_my"
BR2_LINUX_KERNEL_CONFIG_FRAGMENT_FILES="$(LINUX_DIR)/arch/arm/configs/rk3506-usb-otg.config $(LINUX_DIR)/arch/arm/configs/rk3506-my-docker.config $(LINUX_DIR)/arch/arm/configs/rk3506-my-sat.config"
BR2_LINUX_KERNEL_IMAGE_TARGET_CUSTOM=y
BR2_LINUX_KERNEL_IMAGE_TARGET_NAME="rk3506b-evb1-v10-my-sat.img BOOT_ITS=boot-emmc.its"
BR2_LINUX_KERNEL_IMAGE_NAME="zImage"
BR2_LINUX_KERNEL_DTS_SUPPORT=y
BR2_LINUX_KERNEL_DTB_IS_SELF_BUILT=y
BR2_LINUX_KERNEL_INTREE_DTS_NAME="rk3506b-evb1-v10-my-sat"
BR2_PACKAGE_LINUX_TOOLS_GPIO=y
BR2_PACKAGE_ROCKCHIP=y
BR2_PACKAGE_RK3506=y
BR2_PACKAGE_BUSYBOX_CONFIG_FRAGMENT_FILES="board/rockchip/common/base/busybox.fragment"
BR2_PACKAGE_BUSYBOX_SHOW_OTHERS=y
BR2_PACKAGE_DOSFSTOOLS=y
BR2_PACKAGE_DOSFSTOOLS_FATLABEL=y
BR2_PACKAGE_DOSFSTOOLS_FSCK_FAT=y
BR2_PACKAGE_DOSFSTOOLS_MKFS_FAT=y
BR2_PACKAGE_E2FSPROGS=y
BR2_PACKAGE_E2FSPROGS_RESIZE2FS=y
BR2_PACKAGE_FATRESIZE=y
BR2_PACKAGE_MTD=y
BR2_PACKAGE_EUDEV_RULES_GEN=y
BR2_PACKAGE_EVTEST=y
BR2_PACKAGE_INPUT_EVENT_DAEMON=y
BR2_PACKAGE_MEMTESTER=y
BR2_PACKAGE_MHZ=y
BR2_PACKAGE_MINICOM=y
BR2_PACKAGE_NANOCOM=y
BR2_PACKAGE_PM_UTILS=y
BR2_PACKAGE_SYSSTAT=y
BR2_PACKAGE_USBMOUNT=y
BR2_PACKAGE_PYTHON3=y
BR2_PACKAGE_PYTHON_AIOFILES=y
BR2_PACKAGE_PYTHON_AIOHTTP=y
BR2_PACKAGE_PYTHON_CANOPEN=y
BR2_PACKAGE_PYTHON_COLORLOG=y
BR2_PACKAGE_PYTHON_PERIPHERY=y
BR2_PACKAGE_PYTHON_PILLOW=y
BR2_PACKAGE_PYTHON_PIP=y
BR2_PACKAGE_PYTHON_PSUTIL=y
BR2_PACKAGE_PYTHON_SMBUS_CFFI=y
BR2_PACKAGE_PYTHON_SPIDEV=y
BR2_PACKAGE_PYTHON_WEBSOCKETS=y
BR2_PACKAGE_GNUTLS=y
BR2_PACKAGE_LIBOPENSSL_BIN=y
BR2_PACKAGE_DTC=y
BR2_PACKAGE_DTC_PROGRAMS=y
BR2_PACKAGE_LIBGPIOD=y
BR2_PACKAGE_LIBGPIOD_TOOLS=y
BR2_PACKAGE_CJSON=y
BR2_PACKAGE_CJSON_UTILS=y
BR2_PACKAGE_LIBSOCKETCAN=y
BR2_PACKAGE_LIBCAP=y
BR2_PACKAGE_LIBEVDEV=y
BR2_PACKAGE_BRIDGE_UTILS=y
BR2_PACKAGE_DNSMASQ=y
BR2_PACKAGE_GESFTPSERVER=y
BR2_PACKAGE_HOSTAPD=y
BR2_PACKAGE_IPERF3=y
BR2_PACKAGE_IPROUTE2=y
BR2_PACKAGE_IPTABLES=y
BR2_PACKAGE_IPTABLES_BPF_NFSYNPROXY=y
BR2_PACKAGE_IPTABLES_NFTABLES=y
BR2_PACKAGE_IPUTILS=y
BR2_PACKAGE_IW=y
BR2_PACKAGE_LRZSZ=y
BR2_PACKAGE_NTP=y
BR2_PACKAGE_OPENSSH=y
BR2_PACKAGE_OPENSSH_GEN_KEYS=y
BR2_PACKAGE_OPENVPN=y
BR2_PACKAGE_PHYTOOL=y
BR2_PACKAGE_SOCAT=y
BR2_PACKAGE_TCPDUMP=y
BR2_PACKAGE_WGET=y
BR2_PACKAGE_WIRELESS_REGDB=y
BR2_PACKAGE_WIRELESS_TOOLS=y
BR2_PACKAGE_WIRELESS_TOOLS_LIB=y
BR2_PACKAGE_WPA_SUPPLICANT=y
BR2_PACKAGE_BASH_COMPLETION=y
BR2_PACKAGE_DIALOG=y
BR2_PACKAGE_TIME=y
BR2_PACKAGE_ANDROID_TOOLS=y
BR2_PACKAGE_ANDROID_TOOLS_FASTBOOT=y
BR2_PACKAGE_ANDROID_TOOLS_ADB=y
BR2_PACKAGE_ANDROID_TOOLS_ADBD=y
BR2_PACKAGE_HTOP=y
BR2_PACKAGE_TAR=y
BR2_PACKAGE_UTIL_LINUX_LIBFDISK=y
BR2_PACKAGE_UTIL_LINUX_AGETTY=y
BR2_PACKAGE_UTIL_LINUX_HWCLOCK=y
BR2_PACKAGE_UTIL_LINUX_MOUNT=y
BR2_PACKAGE_VIM=y
BR2_TARGET_ROOTFS_EXT2=y
BR2_TARGET_ROOTFS_EXT2_4=y
BR2_TARGET_ROOTFS_EXT2_SIZE="960M"
BR2_TARGET_ROOTFS_EXT2_MKFS_OPTIONS="-O ^64bit,^huge_file"
# BR2_TARGET_ROOTFS_TAR is not set
BR2_TARGET_UBOOT=y
BR2_TARGET_UBOOT_BUILD_SYSTEM_KCONFIG=y
BR2_TARGET_UBOOT_CUSTOM_GIT=y
BR2_TARGET_UBOOT_CUSTOM_REPO_URL="git@github.com:newayer/my-uboot.git"
BR2_TARGET_UBOOT_CUSTOM_REPO_VERSION="br_my_rk3506"
BR2_TARGET_UBOOT_BOARD_DEFCONFIG="rk3506"
BR2_TARGET_UBOOT_CONFIG_FRAGMENT_FILES="$(UBOOT_DIR)/configs/rk3506b.config $(UBOOT_DIR)/configs/rk-emmc.config"
BR2_TARGET_UBOOT_NEEDS_DTC=y
BR2_TARGET_UBOOT_NEEDS_PYLIBFDT=y
# BR2_TARGET_UBOOT_FORMAT_BIN is not set
BR2_TARGET_UBOOT_FORMAT_CUSTOM=y
BR2_TARGET_UBOOT_FORMAT_CUSTOM_NAME="uboot.img"
BR2_TARGET_UBOOT_RK=y
BR2_PACKAGE_HOST_CRAMFS=y
BR2_PACKAGE_HOST_DOSFSTOOLS=y
BR2_PACKAGE_HOST_ENVIRONMENT_SETUP=y
BR2_PACKAGE_HOST_EROFS_UTILS=y
BR2_PACKAGE_HOST_GENIMAGE=y
BR2_PACKAGE_HOST_NTFS_3G=y
BR2_PACKAGE_HOST_PYTHON3=y
BR2_PACKAGE_HOST_PYTHON3_SSL=y
BR2_PACKAGE_HOST_SQUASHFS=y
BR2_PACKAGE_HOST_SWIG=y
BR2_PACKAGE_HOST_UBOOT_TOOLS=y
BR2_PACKAGE_HOST_UBOOT_TOOLS_FIT_SUPPORT=y
BR2_PACKAGE_HOST_UBOOT_TOOLS_FIT_SIGNATURE_SUPPORT=y
BR2_PACKAGE_PYTHON_AIOMQTT=y
BR2_PACKAGE_PYTHON_IOCTL_OPT=y
BR2_PACKAGE_PYTHON_QUART=y
BR2_PACKAGE_PYTHON_SERIAL_PACKETS=y
BR2_PACKAGE_RKBIN=y
BR2_PACKAGE_AIC8800DC=y
BR2_PACKAGE_WORKSITE_D=y
BR2_PACKAGE_WORKSITE_D_URL="git@github.com:newayer/worksite-d.git"
BR2_PACKAGE_WORKSITE_D_VERSION="v1.0.1"
BR2_PACKAGE_WORKSITE_D_SAT=y
BR2_PACKAGE_INIT_SCRIPTS=y
BR2_PACKAGE_INIT_SCRIPT_MOUNT=y
BR2_PACKAGE_INIT_SCRIPT_LINK_RK3506=y
BR2_PACKAGE_INIT_SCRIPT_TIME=y
BR2_PACKAGE_INIT_SCRIPT_ADB=y
```

## vendor/configs/rockchip_rk3506_vanxoak_defconfig
```kconfig
BR2_arm=y
BR2_cortex_a7=y
BR2_PACKAGE_HOST_LINUX_HEADERS_CUSTOM_6_1=y
BR2_TOOLCHAIN_BUILDROOT_CXX=y
BR2_PRIMARY_SITE="https://sources.buildroot.net"
BR2_BACKUP_SITE=""
BR2_GNU_MIRROR="https://mirrors.ustc.edu.cn/gnu"
BR2_FORCE_HOST_BUILD=y
BR2_TIME_BITS_64=y
BR2_TARGET_GENERIC_HOSTNAME="rk3506"
BR2_TARGET_GENERIC_ISSUE="Welcome to RK3506 Buildroot"
BR2_ROOTFS_DEVICE_CREATION_DYNAMIC_EUDEV=y
BR2_ROOTFS_MERGED_USR=y
BR2_TARGET_GENERIC_ROOT_PASSWD="root"
# BR2_TARGET_GENERIC_REMOUNT_ROOTFS_RW is not set
BR2_ROOTFS_OVERLAY="board/rockchip/common/base board/rockchip/rk3506/fs-overlay/ board/rockchip/rk3506/fast-display-overlay/"
BR2_ROOTFS_POST_BUILD_SCRIPT="board/rockchip/common/post-build.sh board/rockchip/rk3506/post-build-fast-display.sh"
BR2_LINUX_KERNEL_CUSTOM_LOCAL=y
BR2_LINUX_KERNEL_CUSTOM_LOCAL_LOCATION="$(TOPDIR)/../build-${VANXOAK_CUSTOMER_NAME}/kernel"
BR2_PACKAGE_LINUX_TOOLS_GPIO=y
BR2_PACKAGE_ROCKCHIP=y
BR2_PACKAGE_RK3506=y
# BR2_PACKAGE_COMMON_ALGORITHM_RKAPPLUS is not set
BR2_PACKAGE_LVGL_DEMO=y
BR2_LVGL_DEMO_RK_DEMO=y
BR2_RK_DEMO_ENABLE_MULTIMEDIA=y
BR2_PACKAGE_RECOVERY=y
BR2_PACKAGE_RECOVERY_NO_UI=y
BR2_PACKAGE_RECOVERY_USE_UPDATEENGINE=y
BR2_PACKAGE_RKADK_EXAMPLES=y
BR2_PACKAGE_RKSCRIPT=y
BR2_PACKAGE_RKTOOLKIT=y
BR2_PACKAGE_RKWIFIBT=y
BR2_PACKAGE_ROCKCHIP_RGA=y
BR2_PACKAGE_ROCKCHIP_TEST=y
BR2_PACKAGE_BUSYBOX_CONFIG_FRAGMENT_FILES="board/rockchip/common/base/busybox.fragment"
BR2_PACKAGE_BUSYBOX_SHOW_OTHERS=y
BR2_PACKAGE_BLUEZ_ALSA_HCITOP=y
BR2_PACKAGE_LVGL=y
BR2_LV_COLOR_DEPTH_32=y
BR2_LV_COLOR_SCREEN_TRANSP=y
BR2_LV_COLOR_MIX_ROUND_OFS=128
BR2_LV_MEM_CUSTOM=y
BR2_LV_MEMCPY_MEMSET_STD=y
BR2_LV_DISP_DEF_REFR_PERIOD=16
BR2_LV_INDEV_DEF_READ_PERIOD=16
BR2_LV_TICK_CUSTOM=y
BR2_LV_TICK_CUSTOM_INCLUDE="src/misc/lv_systick.h"
BR2_LV_IMG_CACHE_DEF_SIZE=500
BR2_LV_USE_LOG=y
BR2_LV_LOG_PRINTF=y
# BR2_LV_LOG_TRACE_MEM is not set
# BR2_LV_LOG_TRACE_TIMER is not set
# BR2_LV_LOG_TRACE_INDEV is not set
# BR2_LV_LOG_TRACE_DISP_REFR is not set
# BR2_LV_LOG_TRACE_EVENT is not set
# BR2_LV_LOG_TRACE_OBJ_CREATE is not set
# BR2_LV_LOG_TRACE_LAYOUT is not set
# BR2_LV_LOG_TRACE_ANIM is not set
BR2_LV_SPRINTF_CUSTOM=y
BR2_LV_USE_LARGE_COORD=y
BR2_LV_FONT_MONTSERRAT_12=y
BR2_LV_FONT_MONTSERRAT_14=y
BR2_LV_FONT_MONTSERRAT_16=y
BR2_LV_FONT_MONTSERRAT_18=y
BR2_LV_FONT_MONTSERRAT_20=y
BR2_LV_FONT_MONTSERRAT_24=y
BR2_LV_FONT_MONTSERRAT_32=y
BR2_LV_FONT_MONTSERRAT_48=y
BR2_LV_FONT_FMT_TXT_LARGE=y
# BR2_LV_USE_THEME_BASIC is not set
BR2_LV_USE_FS_STDIO=y
BR2_LV_FS_STDIO_LETTER=65
BR2_LV_FS_STDIO_CACHE_SIZE=0
BR2_LV_USE_PNG=y
BR2_LV_USE_BMP=y
BR2_LV_USE_SJPG=y
BR2_LV_USE_GIF=y
BR2_LV_USE_FREETYPE=y
BR2_PACKAGE_LV_DRIVERS=y
BR2_LV_DRIVERS_USE_RKADK=y
BR2_PACKAGE_RIPGREP=y
BR2_PACKAGE_DOSFSTOOLS=y
BR2_PACKAGE_DOSFSTOOLS_FATLABEL=y
BR2_PACKAGE_DOSFSTOOLS_FSCK_FAT=y
BR2_PACKAGE_DOSFSTOOLS_MKFS_FAT=y
BR2_PACKAGE_E2FSPROGS=y
BR2_PACKAGE_E2FSPROGS_RESIZE2FS=y
BR2_PACKAGE_FATRESIZE=y
BR2_PACKAGE_MTD=y
BR2_PACKAGE_EVTEST=y
BR2_PACKAGE_INPUT_EVENT_DAEMON=y
BR2_PACKAGE_MHZ=y
BR2_PACKAGE_PM_UTILS=y
BR2_PACKAGE_USBMOUNT=y
BR2_PACKAGE_PYTHON3=y
BR2_PACKAGE_PYTHON_PIP=y
BR2_PACKAGE_LIBGPIOD=y
BR2_PACKAGE_LIBGPIOD_TOOLS=y
BR2_PACKAGE_LIBSOCKETCAN=y
BR2_PACKAGE_LIBCAP=y
BR2_PACKAGE_CAN_UTILS=y
BR2_PACKAGE_DHCPCD=y
BR2_PACKAGE_GESFTPSERVER=y
BR2_PACKAGE_HOSTAPD=y
BR2_PACKAGE_IPROUTE2=y
BR2_PACKAGE_OPENSSH=y
BR2_PACKAGE_OPENSSH_GEN_KEYS=y
BR2_PACKAGE_WPA_SUPPLICANT_AP_SUPPORT=y
BR2_PACKAGE_WPA_SUPPLICANT_AUTOSCAN=y
BR2_PACKAGE_WPA_SUPPLICANT_EAP=y
BR2_PACKAGE_WPA_SUPPLICANT_PASSPHRASE=y
BR2_PACKAGE_ANDROID_ADBD=y
BR2_PACKAGE_UTIL_LINUX_MOUNT=y
BR2_TARGET_ROOTFS_CPIO=y
BR2_TARGET_ROOTFS_CPIO_GZIP=y
BR2_TARGET_ROOTFS_EXT2=y
BR2_TARGET_ROOTFS_EXT2_4=y
BR2_TARGET_ROOTFS_EXT2_SIZE_AUTO=y
BR2_TARGET_ROOTFS_SQUASHFS=y
BR2_TARGET_ROOTFS_SQUASHFS4_ZSTD=y
BR2_TARGET_ROOTFS_UBI=y
BR2_TARGET_ROOTFS_UBI_SUBSIZE=2048
BR2_TARGET_ROOTFS_UBI_OPTS="-v"
BR2_TARGET_ROOTFS_UBIFS_LEBSIZE=0x1f000
BR2_TARGET_ROOTFS_UBIFS_MAX_SIZE=1024
BR2_TARGET_ROOTFS_UBIFS_OPTS="-F -v"
BR2_PACKAGE_HOST_ENVIRONMENT_SETUP=y
BR2_PACKAGE_HOST_NTFS_3G=y
BR2_PACKAGE_HOST_PYTHON3=y
BR2_PACKAGE_HOST_PYTHON3_SSL=y
```

## vendor/configs/tl_emmc_iop_defconfig
```kconfig
BR2_arm=y
BR2_cortex_a7=y
BR2_ARM_FPU_NEON_VFPV4=y
BR2_PACKAGE_HOST_LINUX_HEADERS_CUSTOM_4_9=y
BR2_TOOLCHAIN_BUILDROOT_CXX=y
BR2_DL_DIR="$(TOPDIR)/../my-buildroot-dl"
BR2_PACKAGE_OVERRIDE_FILE="vendor/board/newayer/iop-tl/iop-tl.mk"
BR2_TARGET_GENERIC_HOSTNAME="iop"
BR2_TARGET_GENERIC_ISSUE="Welcome to iop"
BR2_ROOTFS_DEVICE_CREATION_DYNAMIC_EUDEV=y
BR2_TARGET_GENERIC_ROOT_PASSWD="Iop1234%"
BR2_SYSTEM_BIN_SH_BASH=y
BR2_TARGET_GENERIC_GETTY_PORT="ttymxc0"
BR2_ROOTFS_OVERLAY="vendor/board/newayer/common/rootfs_overlay"
BR2_ROOTFS_POST_BUILD_SCRIPT="vendor/board/newayer/common/post-build.sh"
BR2_LINUX_KERNEL=y
BR2_LINUX_KERNEL_CUSTOM_GIT=y
BR2_LINUX_KERNEL_CUSTOM_REPO_URL="git@github.com:newayer/my-kernel.git"
BR2_LINUX_KERNEL_CUSTOM_REPO_VERSION="br_iop_imx6ull_tl"
BR2_LINUX_KERNEL_DEFCONFIG="my_imx_v7_iop"
BR2_LINUX_KERNEL_DTS_SUPPORT=y
BR2_LINUX_KERNEL_INTREE_DTS_NAME="my-imx6ull-emmc-iop"
BR2_LINUX_KERNEL_NEEDS_HOST_OPENSSL=y
BR2_PACKAGE_BUSYBOX_SHOW_OTHERS=y
BR2_PACKAGE_BZIP2=y
BR2_PACKAGE_MTD=y
BR2_PACKAGE_EUDEV_RULES_GEN=y
BR2_PACKAGE_FREESCALE_IMX=y
BR2_PACKAGE_FREESCALE_IMX_PLATFORM_IMX6UL=y
BR2_PACKAGE_FIRMWARE_IMX=y
BR2_PACKAGE_MINICOM=y
BR2_PACKAGE_NANOCOM=y
BR2_PACKAGE_C_PERIPHERY=y
BR2_PACKAGE_CJSON=y
BR2_PACKAGE_AUTOSSH=y
BR2_PACKAGE_BRIDGE_UTILS=y
BR2_PACKAGE_IPROUTE2=y
BR2_PACKAGE_IPTABLES=y
BR2_PACKAGE_OPENSSH=y
BR2_PACKAGE_SOCAT=y
BR2_PACKAGE_SSHPASS=y
BR2_PACKAGE_TCPDUMP=y
BR2_PACKAGE_WGET=y
BR2_PACKAGE_BASH_COMPLETION=y
BR2_PACKAGE_TAR=y
BR2_PACKAGE_UTIL_LINUX_LIBFDISK=y
BR2_PACKAGE_UTIL_LINUX_HWCLOCK=y
BR2_TARGET_ROOTFS_CPIO=y
BR2_TARGET_ROOTFS_CPIO_GZIP=y
BR2_TARGET_ROOTFS_CPIO_UIMAGE=y
BR2_TARGET_ROOTFS_EXT2=y
BR2_TARGET_ROOTFS_EXT2_4=y
BR2_TARGET_ROOTFS_EXT2_SIZE="480M"
BR2_TARGET_ROOTFS_EXT2_MKFS_OPTIONS="-t ext4 -F -O ^metadata_csum,^64bit"
BR2_TARGET_ROOTFS_TAR_BZIP2=y
BR2_TARGET_UBOOT=y
BR2_TARGET_UBOOT_BOARDNAME="mx6ul_14x14_evk_emmc"
BR2_TARGET_UBOOT_CUSTOM_GIT=y
BR2_TARGET_UBOOT_CUSTOM_REPO_URL="git@github.com:newayer/my-uboot.git"
BR2_TARGET_UBOOT_CUSTOM_REPO_VERSION="br_iop_imx6ull_tl"
BR2_TARGET_UBOOT_NEEDS_DTC=y
BR2_TARGET_UBOOT_FORMAT_IMX=y
BR2_PACKAGE_HOST_DOSFSTOOLS=y
BR2_PACKAGE_HOST_GENIMAGE=y
BR2_PACKAGE_HOST_MTOOLS=y
BR2_PACKAGE_INIT_SCRIPTS=y
```

## vendor/package/init-scripts/Config.in
```kconfig
menuconfig BR2_PACKAGE_INIT_SCRIPTS
	bool "init scripts for projects"
	help
	  Set of init scripts used by SystemV init.

if BR2_PACKAGE_INIT_SCRIPTS

config BR2_PACKAGE_INIT_SCRIPT_MOUNT
	bool "init script for partions mount"
	default n
	help
	  partion mount

if BR2_PACKAGE_INIT_SCRIPT_MOUNT
	choice
		prompt "mount partion storage type select"
		default BR2_PACKAGE_INIT_SCRIPT_MOUNT_EMMC

		config BR2_PACKAGE_INIT_SCRIPT_MOUNT_EMMC
			bool "emmc storage"
			help
			  emmc storage

		config BR2_PACKAGE_INIT_SCRIPT_MOUNT_NAND
			bool "spi nand storage"
			help
			  spi nand storage

		config BR2_PACKAGE_INIT_SCRIPT_MOUNT_NOR
			bool "nor flash storage"
			help
			  nor flash storage
	endchoice

	choice
		prompt "link dev select"
		default BR2_PACKAGE_INIT_SCRIPT_LINK_RV1106

		config BR2_PACKAGE_INIT_SCRIPT_LINK_RV1106
			bool "using rv1106 link deveices"
			help
			  using rv1106 link deveices

		config BR2_PACKAGE_INIT_SCRIPT_LINK_RK3506
			bool "using rk3506 link deveices"
			help
			  using rk3506 link deveices
	endchoice
endif

config BR2_PACKAGE_INIT_SCRIPT_TIME
	bool "init script for system time sync"
	default n
	help
	  system time sync

config BR2_PACKAGE_INIT_SCRIPT_DAEMON_WIFI
	bool "init script for wifi client monitor"
	default n
	help
	  wifi client monitor

config BR2_PACKAGE_INIT_SCRIPT_ADB
	bool "init script for adb tools"
	default n
	help
	  adb tools

if BR2_PACKAGE_INIT_SCRIPT_ADB
	config BR2_PACKAGE_INIT_SCRIPT_USB_ADB
		bool "adb"
		default y
		help
		  adb

	config BR2_PACKAGE_INIT_SCRIPT_USB_UMS
		bool "ums"
		help
		  ums

	config BR2_PACKAGE_INIT_SCRIPT_USB_MTP
		bool "mtp"
		help
		  mtp

	config BR2_PACKAGE_INIT_SCRIPT_USB_NTB
		bool "ntb"
		help
		  ntb

	config BR2_PACKAGE_INIT_SCRIPT_USB_ACM
		bool "acm"
		help
		  acm

	config BR2_PACKAGE_INIT_SCRIPT_USB_UAC1
		bool "uac1"
		help
		  uac1

	config BR2_PACKAGE_INIT_SCRIPT_USB_UAC2
		bool "uac2"
		help
		  uac2

	config BR2_PACKAGE_INIT_SCRIPT_USB_UVC
		bool "uvc"
		help
		  uvc

	config BR2_PACKAGE_INIT_SCRIPT_USB_RNDIS
		bool "rndis"
		help
		  rndis

	config BR2_PACKAGE_INIT_SCRIPT_USB_HID
		bool "hid"
		help
		  hid
endif

config BR2_PACKAGE_INIT_SCRIPT_NAT
	bool "init scripts net nat"
	default n
	help
	  net nat

config BR2_PACKAGE_INIT_SCRIPT_ETH
	bool "config the eth iface to static IP"
	default n
	depends on BR2_PACKAGE_BUSYBOX || BR2_PACKAGE_IFUPDOWN
	help
	  config the eth iface to static IP

if BR2_PACKAGE_INIT_SCRIPT_ETH
config BR2_PACKAGE_INIT_SCRIPT_ETH_NAME
	string "Network interface to configure with static IP"
	default "eth0"
	help
	  Enter here the name of the network interface (E.G. eth0) to
	  configure with static IP at bootup.

config BR2_PACKAGE_INIT_SCRIPT_ETH_IP
	string "configured IP for Network interface"
	default "192.168.11.7"
	help
	  Enter here the IP of the network interface (E.G. eth0) to
	  configure at bootup.
endif

config BR2_PACKAGE_INIT_SCRIPT_ETH2
	bool "config the eth2 iface to static IP"
	default n
	depends on BR2_PACKAGE_BUSYBOX || BR2_PACKAGE_IFUPDOWN
	help
	  config the eth2 iface to static IP

if BR2_PACKAGE_INIT_SCRIPT_ETH2
config BR2_PACKAGE_INIT_SCRIPT_ETH2_NAME
	string "Network interface to configure with static IP"
	default "eth1"
	help
	  Enter here the name of the network interface (E.G. eth1) to
	  configure with static IP at bootup.

config BR2_PACKAGE_INIT_SCRIPT_ETH2_IP
	string "configured IP for Network interface"
	default "192.168.22.7"
	help
	  Enter here the IP of the network interface (E.G. eth1) to
	  configure at bootup.
endif

endif
```
