## vendor/Config.in
```kconfig
menu "newayer extendsions"
#thirtparty
    source "$BR2_EXTERNAL_NEWAYER_PATH/package/lua-mosquitto/Config.in"
    source "$BR2_EXTERNAL_NEWAYER_PATH/package/luamqtt/Config.in"
    source "$BR2_EXTERNAL_NEWAYER_PATH/package/openresty/Config.in"
    source "$BR2_EXTERNAL_NEWAYER_PATH/package/openresty-luajit/Config.in"
    source "$BR2_EXTERNAL_NEWAYER_PATH/package/python-grpcio/Config.in"
    source "$BR2_EXTERNAL_NEWAYER_PATH/package/python-jsonpath-rw/Config.in"
    source "$BR2_EXTERNAL_NEWAYER_PATH/package/python-pyfiglet/Config.in"
    source "$BR2_EXTERNAL_NEWAYER_PATH/package/python-pyinquirer/Config.in"
    source "$BR2_EXTERNAL_NEWAYER_PATH/package/python-thingsboard-gateway/Config.in"

#Owner
    source "$BR2_EXTERNAL_NEWAYER_PATH/package/paver/Config.in"

endmenu
```

## vendor/configs/luckfox_pico_plus_defconfig
```kconfig
BR2_arm=y
BR2_cortex_a7=y
BR2_TOOLCHAIN_EXTERNAL=y
BR2_TOOLCHAIN_EXTERNAL_CUSTOM=y
BR2_TOOLCHAIN_EXTERNAL_DOWNLOAD=y
BR2_TOOLCHAIN_EXTERNAL_URL="file://$(BR2_EXTERNAL_NEWAYER_PATH)/tools/toolchain/arm-rockchip830-linux-uclibcgnueabihf.tar.xz"
BR2_TOOLCHAIN_EXTERNAL_CUSTOM_PREFIX="arm-rockchip830-linux-uclibcgnueabihf"
BR2_TOOLCHAIN_EXTERNAL_GCC_8=y
BR2_TOOLCHAIN_EXTERNAL_HEADERS_5_10=y
BR2_TOOLCHAIN_EXTERNAL_WCHAR=y
BR2_TOOLCHAIN_EXTERNAL_HAS_SSP=y
BR2_TOOLCHAIN_EXTERNAL_CXX=y
BR2_DL_DIR="$(TOPDIR)/../my-buildroot-dl"
BR2_PRIMARY_SITE="http://sources.buildroot.net"
BR2_OPTIMIZE_3=y
BR2_PACKAGE_OVERRIDE_FILE="vendor/board/newayer/luckfox-pico/luckfox-pico.mk"
BR2_TARGET_GENERIC_HOSTNAME="luckfox pico"
BR2_TARGET_GENERIC_ISSUE="Welcome to luckfox pico"
BR2_ROOTFS_DEVICE_CREATION_DYNAMIC_EUDEV=y
BR2_TARGET_GENERIC_ROOT_PASSWD="Gwq1234%"
BR2_SYSTEM_BIN_SH_BASH=y
BR2_SYSTEM_DHCP="eth0"
BR2_ROOTFS_OVERLAY="vendor/board/newayer/common/rootfs_overlay"
BR2_ROOTFS_POST_BUILD_SCRIPT="vendor/board/newayer/common/post-build.sh"
BR2_ROOTFS_POST_IMAGE_SCRIPT="vendor/board/newayer/luckfox-pico/post-images.sh"
BR2_LINUX_KERNEL=y
BR2_LINUX_KERNEL_CUSTOM_GIT=y
BR2_LINUX_KERNEL_CUSTOM_REPO_URL="git@github.com:newayer/my-kernel.git"
BR2_LINUX_KERNEL_CUSTOM_REPO_VERSION="br_luckfox"
BR2_LINUX_KERNEL_DEFCONFIG="luckfox_rv1106_linux"
BR2_LINUX_KERNEL_IMAGE_TARGET_CUSTOM=y
BR2_LINUX_KERNEL_IMAGE_TARGET_NAME="rv1103g-luckfox-pico-plus.img BOOT_ITS=boot.its"
BR2_LINUX_KERNEL_IMAGE_NAME="zImage"
BR2_LINUX_KERNEL_DTS_SUPPORT=y
BR2_LINUX_KERNEL_INTREE_DTS_NAME="rv1103g-luckfox-pico-plus"
BR2_LINUX_KERNEL_DTB_OVERLAY_SUPPORT=y
BR2_PACKAGE_BUSYBOX_SHOW_OTHERS=y
BR2_PACKAGE_BZIP2=y
BR2_PACKAGE_STRACE=y
BR2_PACKAGE_STRESS=y
BR2_PACKAGE_E2FSPROGS_RESIZE2FS=y
BR2_PACKAGE_MTD=y
BR2_PACKAGE_EUDEV_RULES_GEN=y
BR2_PACKAGE_MEMTESTER=y
BR2_PACKAGE_MINICOM=y
BR2_PACKAGE_NANOCOM=y
BR2_PACKAGE_SYSSTAT=y
BR2_PACKAGE_PYTHON3=y
BR2_PACKAGE_PYTHON3_SSL=y
BR2_PACKAGE_PYTHON_AIOHTTP=y
BR2_PACKAGE_PYTHON_CLICK=y
BR2_PACKAGE_PYTHON_ITSDANGEROUS=y
BR2_PACKAGE_PYTHON_JINJA2=y
BR2_PACKAGE_PYTHON_PERIPHERY=y
BR2_PACKAGE_PYTHON_PILLOW=y
BR2_PACKAGE_PYTHON_SERIAL=y
BR2_PACKAGE_PYTHON_SETUPTOOLS=y
BR2_PACKAGE_PYTHON_SMBUS_CFFI=y
BR2_PACKAGE_PYTHON_SPIDEV=y
BR2_PACKAGE_PYTHON_WERKZEUG=y
BR2_PACKAGE_DTC=y
BR2_PACKAGE_DTC_PROGRAMS=y
BR2_PACKAGE_LIBV4L=y
BR2_PACKAGE_LIBV4L_UTILS=y
BR2_PACKAGE_AUTOSSH=y
BR2_PACKAGE_LRZSZ=y
BR2_PACKAGE_NTP=y
BR2_PACKAGE_OPENSSH=y
BR2_PACKAGE_PPPD=y
BR2_PACKAGE_PPPD_FILTER=y
BR2_PACKAGE_PPPD_RADIUS=y
BR2_PACKAGE_SAMBA4=y
BR2_PACKAGE_WGET=y
BR2_PACKAGE_BASH_LOADABLE_EXAMPLES=y
BR2_PACKAGE_BASH_COMPLETION=y
BR2_PACKAGE_DIALOG=y
BR2_PACKAGE_TIME=y
BR2_PACKAGE_ANDROID_TOOLS=y
BR2_PACKAGE_ANDROID_TOOLS_FASTBOOT=y
BR2_PACKAGE_ANDROID_TOOLS_ADB=y
BR2_PACKAGE_ANDROID_TOOLS_ADBD=y
BR2_PACKAGE_HTOP=y
BR2_PACKAGE_TAR=y
BR2_PACKAGE_UTIL_LINUX_LIBFDISK=y
BR2_PACKAGE_UTIL_LINUX_HWCLOCK=y
BR2_PACKAGE_NANO=y
# BR2_TARGET_ROOTFS_TAR is not set
BR2_TARGET_ROOTFS_UBI=y
BR2_TARGET_ROOTFS_UBI_SUBSIZE=2048
BR2_TARGET_ROOTFS_UBIFS_LEBSIZE=0x1f000
BR2_TARGET_ROOTFS_UBIFS_MAXLEBCNT=908
BR2_TARGET_ROOTFS_UBIFS_OPTS="-F -v"
BR2_TARGET_UBOOT=y
BR2_TARGET_UBOOT_BUILD_SYSTEM_KCONFIG=y
BR2_TARGET_UBOOT_CUSTOM_GIT=y
BR2_TARGET_UBOOT_CUSTOM_REPO_URL="git@github.com:newayer/my-uboot.git"
BR2_TARGET_UBOOT_CUSTOM_REPO_VERSION="br_luckfox"
BR2_TARGET_UBOOT_BOARD_DEFCONFIG="rv1106"
BR2_TARGET_UBOOT_CONFIG_FRAGMENT_FILES="$(UBOOT_DIR)/configs/rk-sfc.config"
BR2_TARGET_UBOOT_NEEDS_DTC=y
BR2_TARGET_UBOOT_NEEDS_PYLIBFDT=y
# BR2_TARGET_UBOOT_FORMAT_BIN is not set
BR2_TARGET_UBOOT_FORMAT_CUSTOM=y
BR2_TARGET_UBOOT_FORMAT_CUSTOM_NAME="uboot.img"
BR2_TARGET_UBOOT_RK=y
BR2_TARGET_UBOOT_RK_ENV_FILE="$(BR2_EXTERNAL)/board/newayer/luckfox-pico/env.txt"
BR2_PACKAGE_HOST_CRAMFS=y
BR2_PACKAGE_HOST_DOSFSTOOLS=y
BR2_PACKAGE_HOST_E2FSPROGS=y
BR2_PACKAGE_HOST_EROFS_UTILS=y
BR2_PACKAGE_HOST_GENIMAGE=y
BR2_PACKAGE_HOST_MTD=y
BR2_PACKAGE_HOST_MTOOLS=y
BR2_PACKAGE_HOST_SQUASHFS=y
BR2_PACKAGE_HOST_SWIG=y
BR2_PACKAGE_HOST_UBOOT_TOOLS=y
BR2_PACKAGE_HOST_UBOOT_TOOLS_FIT_SUPPORT=y
BR2_PACKAGE_HOST_UBOOT_TOOLS_FIT_SIGNATURE_SUPPORT=y
BR2_PACKAGE_KERNEL_MODULE_KMPP=y
BR2_PACKAGE_RKBIN=y
BR2_PACKAGE_KERNEL_MODULE_ROCKIT=y
BR2_PACKAGE_PPPD_SCRIPTS=y
BR2_PACKAGE_INIT_SCRIPTS=y
BR2_PACKAGE_INIT_SCRIPT_TIME=y
BR2_PACKAGE_INIT_SCRIPT_MOUNT=y
BR2_PACKAGE_INIT_SCRIPT_ADB=y
```

## vendor/configs/luckfox_pico_ultra_storage_defconfig
```kconfig
BR2_arm=y
BR2_cortex_a7=y
BR2_TOOLCHAIN_EXTERNAL=y
BR2_TOOLCHAIN_EXTERNAL_CUSTOM=y
BR2_TOOLCHAIN_EXTERNAL_DOWNLOAD=y
BR2_TOOLCHAIN_EXTERNAL_URL="file://$(BR2_EXTERNAL_NEWAYER_PATH)/tools/toolchain/arm-rockchip830-linux-uclibcgnueabihf.tar.xz"
BR2_TOOLCHAIN_EXTERNAL_CUSTOM_PREFIX="arm-rockchip830-linux-uclibcgnueabihf"
BR2_TOOLCHAIN_EXTERNAL_GCC_8=y
BR2_TOOLCHAIN_EXTERNAL_HEADERS_5_10=y
BR2_TOOLCHAIN_EXTERNAL_WCHAR=y
BR2_TOOLCHAIN_EXTERNAL_HAS_SSP=y
BR2_TOOLCHAIN_EXTERNAL_CXX=y
BR2_DL_DIR="$(TOPDIR)/../my-buildroot-dl"
BR2_PRIMARY_SITE="http://sources.buildroot.net"
BR2_OPTIMIZE_3=y
BR2_PACKAGE_OVERRIDE_FILE="vendor/board/newayer/luckfox-pico/luckfox-pico.mk"
BR2_TARGET_GENERIC_HOSTNAME="storage"
BR2_TARGET_GENERIC_ISSUE="Welcome to storage"
BR2_ROOTFS_DEVICE_CREATION_DYNAMIC_EUDEV=y
BR2_TARGET_GENERIC_ROOT_PASSWD="root"
BR2_SYSTEM_BIN_SH_BASH=y
BR2_ROOTFS_OVERLAY="vendor/board/newayer/common/rootfs_overlay vendor/board/newayer/luckfox-pico/ultra/rootfs_overlay vendor/board/newayer/luckfox-pico/ultra-storage/rootfs_overlay"
BR2_ROOTFS_POST_BUILD_SCRIPT="vendor/board/newayer/common/post-build.sh"
BR2_ROOTFS_POST_IMAGE_SCRIPT="vendor/board/newayer/luckfox-pico/post-images-ultra.sh"
BR2_LINUX_KERNEL=y
BR2_LINUX_KERNEL_CUSTOM_GIT=y
BR2_LINUX_KERNEL_CUSTOM_REPO_URL="git@github.com:newayer/my-kernel.git"
BR2_LINUX_KERNEL_CUSTOM_REPO_VERSION="br_luckfox"
BR2_LINUX_KERNEL_DEFCONFIG="luckfox_rv1106_storage"
BR2_LINUX_KERNEL_IMAGE_TARGET_CUSTOM=y
BR2_LINUX_KERNEL_IMAGE_TARGET_NAME="rv1106g-luckfox-pico-ultra-storage.img BOOT_ITS=boot.its"
BR2_LINUX_KERNEL_IMAGE_NAME="zImage"
BR2_LINUX_KERNEL_DTS_SUPPORT=y
BR2_LINUX_KERNEL_INTREE_DTS_NAME="rv1106g-luckfox-pico-ultra-storage"
BR2_LINUX_KERNEL_DTB_OVERLAY_SUPPORT=y
BR2_PACKAGE_BUSYBOX_SHOW_OTHERS=y
BR2_PACKAGE_BZIP2=y
BR2_PACKAGE_STRACE=y
BR2_PACKAGE_STRESS=y
BR2_PACKAGE_DOSFSTOOLS=y
BR2_PACKAGE_DOSFSTOOLS_FATLABEL=y
BR2_PACKAGE_DOSFSTOOLS_FSCK_FAT=y
BR2_PACKAGE_DOSFSTOOLS_MKFS_FAT=y
BR2_PACKAGE_E2FSPROGS=y
BR2_PACKAGE_E2FSPROGS_RESIZE2FS=y
BR2_PACKAGE_EXFAT=y
BR2_PACKAGE_EXFAT_UTILS=y
BR2_PACKAGE_EXFATPROGS=y
BR2_PACKAGE_EUDEV_RULES_GEN=y
BR2_PACKAGE_MEMTESTER=y
BR2_PACKAGE_MINICOM=y
BR2_PACKAGE_NANOCOM=y
BR2_PACKAGE_SYSSTAT=y
BR2_PACKAGE_C_PERIPHERY=y
BR2_PACKAGE_DTC=y
BR2_PACKAGE_DTC_PROGRAMS=y
BR2_PACKAGE_LIBV4L=y
BR2_PACKAGE_LIBV4L_UTILS=y
BR2_PACKAGE_CJSON=y
BR2_PACKAGE_CJSON_UTILS=y
BR2_PACKAGE_IPERF=y
BR2_PACKAGE_IPERF3=y
BR2_PACKAGE_LRZSZ=y
BR2_PACKAGE_OPENSSH=y
BR2_PACKAGE_SOCAT=y
BR2_PACKAGE_WGET=y
BR2_PACKAGE_BASH_COMPLETION=y
BR2_PACKAGE_DIALOG=y
BR2_PACKAGE_TIME=y
BR2_PACKAGE_ANDROID_TOOLS=y
BR2_PACKAGE_ANDROID_TOOLS_FASTBOOT=y
BR2_PACKAGE_ANDROID_TOOLS_ADB=y
BR2_PACKAGE_ANDROID_TOOLS_ADBD=y
BR2_PACKAGE_HTOP=y
BR2_PACKAGE_UTIL_LINUX_LIBFDISK=y
BR2_PACKAGE_UTIL_LINUX_LIBMOUNT=y
BR2_PACKAGE_UTIL_LINUX_HWCLOCK=y
BR2_PACKAGE_NANO=y
BR2_TARGET_ROOTFS_EXT2=y
BR2_TARGET_ROOTFS_EXT2_4=y
BR2_TARGET_ROOTFS_EXT2_SIZE="768M"
BR2_TARGET_ROOTFS_EXT2_MKFS_OPTIONS="-O ^64bit,^huge_file"
# BR2_TARGET_ROOTFS_TAR is not set
BR2_TARGET_UBOOT=y
BR2_TARGET_UBOOT_BUILD_SYSTEM_KCONFIG=y
BR2_TARGET_UBOOT_CUSTOM_GIT=y
BR2_TARGET_UBOOT_CUSTOM_REPO_URL="git@github.com:newayer/my-uboot.git"
BR2_TARGET_UBOOT_CUSTOM_REPO_VERSION="br_luckfox"
BR2_TARGET_UBOOT_BOARD_DEFCONFIG="luckfox_rv1106_uboot"
BR2_TARGET_UBOOT_CONFIG_FRAGMENT_FILES="$(UBOOT_DIR)/configs/rk-emmc.config"
BR2_TARGET_UBOOT_NEEDS_DTC=y
BR2_TARGET_UBOOT_NEEDS_PYLIBFDT=y
# BR2_TARGET_UBOOT_FORMAT_BIN is not set
BR2_TARGET_UBOOT_FORMAT_CUSTOM=y
BR2_TARGET_UBOOT_FORMAT_CUSTOM_NAME="uboot.img"
BR2_TARGET_UBOOT_RK=y
BR2_TARGET_UBOOT_RK_ENV_SIZE=0x8000
BR2_TARGET_UBOOT_RK_ENV_FILE="$(BR2_EXTERNAL)/board/newayer/luckfox-pico/env_ultra.txt"
BR2_PACKAGE_HOST_CRAMFS=y
BR2_PACKAGE_HOST_DOSFSTOOLS=y
BR2_PACKAGE_HOST_EROFS_UTILS=y
BR2_PACKAGE_HOST_GENIMAGE=y
BR2_PACKAGE_HOST_SQUASHFS=y
BR2_PACKAGE_HOST_SWIG=y
BR2_PACKAGE_HOST_UBOOT_TOOLS=y
BR2_PACKAGE_HOST_UBOOT_TOOLS_FIT_SUPPORT=y
BR2_PACKAGE_HOST_UBOOT_TOOLS_FIT_SIGNATURE_SUPPORT=y
BR2_PACKAGE_KERNEL_MODULE_KMPP=y
BR2_PACKAGE_RKBIN=y
BR2_PACKAGE_KERNEL_MODULE_ROCKIT=y
BR2_PACKAGE_WORKSITE_D=y
BR2_PACKAGE_WORKSITE_D_URL="https://gitee.com/newayer/worksite-d.git"
BR2_PACKAGE_WORKSITE_D_VERSION="v1.0.1"
BR2_PACKAGE_WORKSITE_D_STORAGE=y
BR2_PACKAGE_INIT_SCRIPTS=y
BR2_PACKAGE_INIT_SCRIPT_MOUNT=y
BR2_PACKAGE_INIT_SCRIPT_ADB=y
```

## vendor/configs/topeet_nand_gateway_defconfig
```kconfig
BR2_arm=y
BR2_cortex_a7=y
BR2_ARM_FPU_NEON_VFPV4=y
BR2_PACKAGE_HOST_LINUX_HEADERS_CUSTOM_4_1=y
BR2_TOOLCHAIN_BUILDROOT_CXX=y
BR2_DL_DIR="$(TOPDIR)/../my-buildroot-dl"
BR2_PACKAGE_OVERRIDE_FILE="vendor/board/newayer/topeet-gateway/local-gateway.mk"
BR2_TARGET_GENERIC_HOSTNAME="iot101"
BR2_TARGET_GENERIC_ISSUE="Welcome to iot gateway"
BR2_ROOTFS_DEVICE_CREATION_DYNAMIC_EUDEV=y
BR2_TARGET_GENERIC_ROOT_PASSWD="Xt1234%"
BR2_SYSTEM_BIN_SH_BASH=y
BR2_TARGET_GENERIC_GETTY_PORT="ttymxc0"
BR2_SYSTEM_DHCP="wlan0"
BR2_ROOTFS_OVERLAY="vendor/board/newayer/common/rootfs_overlay vendor/board/newayer/topeet-gateway/rootfs_overlay"
BR2_ROOTFS_POST_BUILD_SCRIPT="vendor/board/newayer/common/post-build.sh"
BR2_LINUX_KERNEL=y
BR2_LINUX_KERNEL_CUSTOM_GIT=y
BR2_LINUX_KERNEL_CUSTOM_REPO_URL="https://gitee.com/newayer/my-kernel.git"
BR2_LINUX_KERNEL_CUSTOM_REPO_VERSION="imx_4.1.15_2.0.0_ga-topeet"
BR2_LINUX_KERNEL_DEFCONFIG="topeet_imx_v7"
BR2_LINUX_KERNEL_DTS_SUPPORT=y
BR2_LINUX_KERNEL_INTREE_DTS_NAME="topeet_nand"
BR2_LINUX_KERNEL_NEEDS_HOST_OPENSSL=y
BR2_PACKAGE_BUSYBOX_SHOW_OTHERS=y
BR2_PACKAGE_BZIP2=y
BR2_PACKAGE_MTD=y
BR2_PACKAGE_EUDEV_RULES_GEN=y
BR2_PACKAGE_FREESCALE_IMX=y
BR2_PACKAGE_FREESCALE_IMX_PLATFORM_IMX6UL=y
BR2_PACKAGE_FIRMWARE_IMX=y
BR2_PACKAGE_MINICOM=y
BR2_PACKAGE_ARGPARSE=y
BR2_PACKAGE_COPAS=y
BR2_PACKAGE_COXPCALL=y
BR2_PACKAGE_LSQLITE3=y
BR2_PACKAGE_LUA_CJSON=y
BR2_PACKAGE_LUA_COMPAT53=y
BR2_PACKAGE_LUA_CURL=y
BR2_PACKAGE_LUA_PERIPHERY=y
BR2_PACKAGE_LUALOGGING=y
BR2_PACKAGE_LUAOSSL=y
BR2_PACKAGE_LUASEC=y
BR2_PACKAGE_LUV=y
BR2_PACKAGE_PYTHON3_SQLITE=y
BR2_PACKAGE_PYTHON_SERIAL=y
BR2_PACKAGE_GIFLIB=y
BR2_PACKAGE_JPEG=y
BR2_PACKAGE_LIBPNG=y
BR2_PACKAGE_C_PERIPHERY=y
BR2_PACKAGE_CJSON=y
BR2_PACKAGE_SPDLOG=y
BR2_PACKAGE_ZLOG=y
BR2_PACKAGE_LIBCURL_CURL=y
BR2_PACKAGE_LIBMICROHTTPD=y
BR2_PACKAGE_LIBWEBSOCKETS=y
BR2_PACKAGE_PCRE_32=y
BR2_PACKAGE_PCRE_UCP=y
BR2_PACKAGE_AUTOSSH=y
BR2_PACKAGE_BRIDGE_UTILS=y
BR2_PACKAGE_IPROUTE2=y
BR2_PACKAGE_IPTABLES=y
BR2_PACKAGE_IW=y
BR2_PACKAGE_OPENSSH=y
BR2_PACKAGE_PPPD=y
BR2_PACKAGE_PPPD_FILTER=y
BR2_PACKAGE_PPPD_RADIUS=y
BR2_PACKAGE_SOCAT=y
BR2_PACKAGE_SSHPASS=y
BR2_PACKAGE_TCPDUMP=y
BR2_PACKAGE_WGET=y
BR2_PACKAGE_WIRELESS_REGDB=y
BR2_PACKAGE_WIRELESS_TOOLS=y
BR2_PACKAGE_WIRELESS_TOOLS_LIB=y
BR2_PACKAGE_WPA_SUPPLICANT=y
BR2_PACKAGE_WPA_SUPPLICANT_AUTOSCAN=y
BR2_PACKAGE_WPA_SUPPLICANT_EAP=y
BR2_PACKAGE_WPA_SUPPLICANT_DEBUG_SYSLOG=y
BR2_PACKAGE_WPA_SUPPLICANT_CLI=y
BR2_PACKAGE_WPA_SUPPLICANT_WPA_CLIENT_SO=y
BR2_PACKAGE_WPA_SUPPLICANT_PASSPHRASE=y
BR2_PACKAGE_WPA_SUPPLICANT_DBUS=y
BR2_PACKAGE_BASH_COMPLETION=y
BR2_PACKAGE_TAR=y
BR2_PACKAGE_UTIL_LINUX_LIBFDISK=y
BR2_PACKAGE_UTIL_LINUX_HWCLOCK=y
BR2_TARGET_ROOTFS_TAR_BZIP2=y
BR2_TARGET_ROOTFS_UBI=y
BR2_TARGET_ROOTFS_UBI_SUBSIZE=2048
BR2_TARGET_ROOTFS_UBIFS_LEBSIZE=0x1f000
BR2_TARGET_ROOTFS_UBIFS_MAXLEBCNT=757
BR2_TARGET_ROOTFS_UBIFS_RT_NONE=y
BR2_TARGET_UBOOT=y
BR2_TARGET_UBOOT_BOARDNAME="mx6ul_14x14_evk_nand"
BR2_TARGET_UBOOT_CUSTOM_GIT=y
BR2_TARGET_UBOOT_CUSTOM_REPO_URL="https://gitee.com/newayer/my-uboot.git"
BR2_TARGET_UBOOT_CUSTOM_REPO_VERSION="topeet-imx_v2016.03_4.1.15_2.0.0_ga"
BR2_TARGET_UBOOT_NEEDS_DTC=y
BR2_TARGET_UBOOT_FORMAT_IMX=y
BR2_PACKAGE_HOST_DOSFSTOOLS=y
BR2_PACKAGE_HOST_GENIMAGE=y
BR2_PACKAGE_HOST_MTOOLS=y
BR2_PACKAGE_LUA_MOSQUITTO=y
BR2_PACKAGE_LUAMQTT=y
BR2_PACKAGE_OPENRESTY=y
BR2_PACKAGE_OPENRESTY_SELECT_MODULE=y
BR2_PACKAGE_OPENRESTY_POLL_MODULE=y
BR2_PACKAGE_OPENRESTY_LUAJIT=y
BR2_PACKAGE_OPENRESTY_LUAJIT_COMPAT52=y
BR2_PACKAGE_PYTHON_THINGSBOARD_GATEWAY=y
BR2_PACKAGE_FIRMWARE_RTL=y
```

## vendor/package/firmware-brcm/Config.in
```kconfig
config BR2_PACKAGE_FIRMWARE_BRCM
	bool "firmware_brcm"
	help
	  Add brcmfmac43362-sdio wifi firmware to rootfs
```

## vendor/package/firmware-rtl/Config.in
```kconfig
config BR2_PACKAGE_FIRMWARE_RTL
	bool "firmware_rtl"
	help
	  Add rtl8723b wifi firmware to rootfs
```

## vendor/package/lua-mosquitto/Config.in
```kconfig
config BR2_PACKAGE_LUA_MOSQUITTO
	bool "lua-mosquitto"
	select BR2_PACKAGE_MOSQUITTO
	help
	  lua bindings to libmosquitto MQTT client library.

	  https://github.com/flukso/lua-mosquitto
```

## vendor/package/luamqtt/Config.in
```kconfig
config BR2_PACKAGE_LUAMQTT
	bool "luamqtt"
	select BR2_PACKAGE_LUASOCKET
	help
	  luamqtt - Pure-lua MQTT v3.1.1 and v5.0 client.

	  https://github.com/xHasKx/luamqtt
```

## vendor/package/opencv-mobile/Config.in
```kconfig
menuconfig BR2_PACKAGE_OPENCV4_MOBILE
	bool "opencv4"
	depends on BR2_TOOLCHAIN_HAS_ATOMIC
	depends on BR2_TOOLCHAIN_HAS_THREADS_NPTL
	depends on BR2_INSTALL_LIBSTDCPP
	depends on BR2_USE_WCHAR
	depends on !BR2_STATIC_LIBS # include dlfcn.h
	depends on BR2_TOOLCHAIN_GCC_AT_LEAST_4_8 # C++11
	depends on !BR2_PACKAGE_OPENCV3
	select BR2_PACKAGE_ZLIB
	help
	  OpenCV (Open Source Computer Vision) is a library of
	  programming functions for real time computer vision.

	  Note that the opencv_core module and the opencv_hal library
	  are always built and installed, not matter which other
	  modules are enabled below.

	  http://opencv.org/

comment "opencv4 needs a toolchain w/ C++, NPTL, wchar, dynamic library, gcc >= 4.8"
	depends on BR2_TOOLCHAIN_HAS_ATOMIC
	depends on !BR2_INSTALL_LIBSTDCPP || \
		!BR2_USE_WCHAR || \
		!BR2_TOOLCHAIN_HAS_THREADS_NPTL || \
		BR2_STATIC_LIBS || !BR2_TOOLCHAIN_GCC_AT_LEAST_4_8
```

## vendor/package/paver/Config.in
```kconfig
config BR2_PACKAGE_PAVER
	bool "paver"
	help
	  Add paver control project to rootfs.

if BR2_PACKAGE_PAVER

comment "Paver Parameters"

config BR2_PACKAGE_PAVER_REPO_URL
	string "URL of custom repository"

config BR2_PACKAGE_PAVER_REPO_VERSION
	string "Custom git repository version"
	help
	  Revision to use in the typical format used by
	  Git E.G. a sha id, a tag

endif # BR2_PACKAGE_PAVER
```
