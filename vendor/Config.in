## vendor/package/pppd-scripts/Config.in
```kconfig
config BR2_PACKAGE_PPPD_SCRIPTS
	bool "pppd start scripts"
	depends on BR2_PACKAGE_PPPD
	help
	  pppd scripts used by system init.

if BR2_PACKAGE_PPPD_SCRIPTS

choice
	prompt "pppd Parameters"
	default BR2_PACKAGE_PPPD_SCRIPTS_EC20
	help
	  Select which modem to pppd

config BR2_PACKAGE_PPPD_SCRIPTS_IRIDIUM
	bool "pppd scripts for iridium"

config BR2_PACKAGE_PPPD_SCRIPTS_EC20
	bool "pppd scripts for ec20"

config BR2_PACKAGE_PPPD_SCRIPTS_TT
	bool "pppd scripts for Tiantong"

endchoice

endif # BR2_PACKAGE_PPPD_SCRIPTS
```

## vendor/package/python-aiomqtt/Config.in
```kconfig
config BR2_PACKAGE_PYTHON_AIOMQTT
	bool "python-aiomqtt"
	select BR2_PACKAGE_PYTHON_PAHO_MQTT # runtime
	help
	  Idiomatic asyncio MQTT Client.

	  https://github.com/empicano/aiomqtt
```

## vendor/package/python-grpcio/Config.in
```kconfig
config BR2_PACKAGE_PYTHON_GRPCIO
	bool "python-grpcio"
	select BR2_PACKAGE_PYTHON_SIX # runtime
	help
	  HTTP/2-based RPC framework.

	  https://grpc.io
```

## vendor/package/python-jsonpath-rw/Config.in
```kconfig
config BR2_PACKAGE_PYTHON_JSONPATH_RW
	bool "python-jsonpath-rw"
	select BR2_PACKAGE_PYTHON_DECORATOR # runtime
	select BR2_PACKAGE_PYTHON_PLY # runtime
	select BR2_PACKAGE_PYTHON_SIX # runtime
	help
	  A robust and significantly extended implementation of
	  JSONPath for Python, with a clear AST for metaprogramming.

	  https://github.com/kennknowles/python-jsonpath-rw
```

## vendor/package/python-thingsboard-gateway/Config.in
```kconfig
config BR2_PACKAGE_PYTHON_THINGSBOARD_GATEWAY
	bool "python-thingsboard-gateway"
	select BR2_PACKAGE_PYTHON3
	select BR2_PACKAGE_PYTHON_GRPCIO # runtime
	select BR2_PACKAGE_PYTHON_JSONPATH_RW # runtime
	select BR2_PACKAGE_PYTHON_PAHO_MQTT # runtime
	select BR2_PACKAGE_PYTHON_PIP # runtime
	select BR2_PACKAGE_PYTHON_PROTOBUF # runtime
	select BR2_PACKAGE_PYTHON_PYFIGLET # runtime
	select BR2_PACKAGE_PYTHON_PYINQUIRER # runtime
	select BR2_PACKAGE_PYTHON_PYYAML # runtime
	select BR2_PACKAGE_PYTHON_REGEX # runtime
	select BR2_PACKAGE_PYTHON_REQUESTS # runtime
	select BR2_PACKAGE_PYTHON_SIMPLEJSON # runtime
	select BR2_PACKAGE_PYTHON_TERMCOLOR # runtime
	help
	  Thingsboard Gateway for IoT devices.

	  https://github.com/thingsboard/thingsboard-gateway
```

## vendor/package/rockchip/kmpp/src/Kconfig
```kconfig
config ROCKCHIP_RV1106_MPP
        tristate "rockchip rv1106 mpp"
        default n
        help
          buildroot.rockchip rv1106 mpp
```

## vendor/package/rockchip/rockit/src/Kconfig
```kconfig
config ROCKCHIP_RV1106_ROCKIT
        tristate "rockchip rv1106 rockit"
        default n
        help
          buildroot.rockchip rv1106 rockit
```

## vendor/package/worksite-d/Config.in
```kconfig
config BR2_PACKAGE_WORKSITE_D
	bool "worksite-d"
	help
	  Add worksite-d project to rootfs.

if BR2_PACKAGE_WORKSITE_D

comment "Worksite-d Parameters"

config BR2_PACKAGE_WORKSITE_D_URL
	string "URL of custom repository"

config BR2_PACKAGE_WORKSITE_D_VERSION
	string "Custom git repository version"
	help
	  Revision to use in the typical format used by
	  Git E.G. a sha id, a tag

choice
	prompt "worksite-d sub project"
	default BR2_PACKAGE_WORKSITE_D_UAV
	help
	  Select which sub project to enable

config BR2_PACKAGE_WORKSITE_D_PAVER
	bool "worksite-d for paver app"

config BR2_PACKAGE_WORKSITE_D_UAV
	bool "worksite-d for uav app"

config BR2_PACKAGE_WORKSITE_D_STORAGE
	bool "worksite-d for storage app"

config BR2_PACKAGE_WORKSITE_D_TIANTONG
	bool "worksite-d for tiantong app"

endchoice

if BR2_PACKAGE_WORKSITE_D_STORAGE
choice
	prompt "storage project options"
	default BR2_STORAGE_DEFAULT
	help
	  Select which sub project to enable

config BR2_STORAGE_DEFAULT
	bool "storage default"

config BR2_STORAGE_RS422
	bool "storage for rs422"
endchoice
endif

endif # BR2_PACKAGE_WORKSITE_D
```
