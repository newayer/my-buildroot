## vendor/Config.in
```kconfig
menu "newayer extendsions"
    source "$BR2_EXTERNAL_NEWAYER_PATH/package/worksite-d/Config.in"
    source "$BR2_EXTERNAL_NEWAYER_PATH/package/init-scripts/Config.in"
endmenu
```

## vendor/configs/my_mfgtool_initramfs_emmc_defconfig
```kconfig
BR2_arm=y
BR2_cortex_a7=y
BR2_ARM_FPU_NEON_VFPV4=y
BR2_DL_DIR="$(TOPDIR)/../my-buildroot-dl"
BR2_PACKAGE_OVERRIDE_FILE="vendor/board/newayer/imx6ull/imx6ull.mk"
BR2_TOOLCHAIN_BUILDROOT_GLIBC=y
BR2_TARGET_GENERIC_HOSTNAME="mfg"
BR2_TARGET_GENERIC_ISSUE="MfgTool Initramfs"
BR2_ROOTFS_DEVICE_CREATION_DYNAMIC_EUDEV=y
BR2_SYSTEM_BIN_SH_BASH=y
BR2_TARGET_GENERIC_GETTY_PORT="ttymxc0"
BR2_ROOTFS_OVERLAY="vendor/board/newayer/common/rootfs_overlay"
BR2_ROOTFS_POST_BUILD_SCRIPT="vendor/board/newayer/common/post-build.sh"
BR2_LINUX_KERNEL=y
BR2_LINUX_KERNEL_CUSTOM_GIT=y
BR2_LINUX_KERNEL_CUSTOM_REPO_URL="git@github.com:newayer/my-kernel.git"
BR2_LINUX_KERNEL_CUSTOM_REPO_VERSION="br_iop_imx6ull_tl"
BR2_LINUX_KERNEL_DEFCONFIG="my_imx_v7_mfg"
BR2_LINUX_KERNEL_DTS_SUPPORT=y
BR2_LINUX_KERNEL_INTREE_DTS_NAME="my-imx6ull-mfg-nand my-imx6ull-mfg-emmc"
BR2_PACKAGE_BUSYBOX_SHOW_OTHERS=y
BR2_PACKAGE_BZIP2=y
BR2_PACKAGE_DOSFSTOOLS=y
BR2_PACKAGE_E2FSPROGS=y
BR2_PACKAGE_E2FSPROGS_RESIZE2FS=y
BR2_PACKAGE_MMC_UTILS=y
BR2_PACKAGE_MTD=y
BR2_PACKAGE_FREESCALE_IMX=y
BR2_PACKAGE_FREESCALE_IMX_PLATFORM_IMX6UL=y
BR2_PACKAGE_IMX_KOBS=y
BR2_PACKAGE_IMX_UUC=y
BR2_PACKAGE_COREUTILS=y
BR2_PACKAGE_TAR=y
BR2_PACKAGE_UTIL_LINUX_LIBFDISK=y
BR2_TARGET_ROOTFS_CPIO=y
BR2_TARGET_ROOTFS_CPIO_GZIP=y
BR2_TARGET_ROOTFS_CPIO_UIMAGE=y
BR2_TARGET_UBOOT=y
BR2_TARGET_UBOOT_BOARDNAME="mx6ul_14x14_evk_emmc"
BR2_TARGET_UBOOT_CUSTOM_GIT=y
BR2_TARGET_UBOOT_CUSTOM_REPO_URL="git@github.com:newayer/my-uboot.git"
BR2_TARGET_UBOOT_CUSTOM_REPO_VERSION="br_iop_imx6ull_tl"
BR2_TARGET_UBOOT_NEEDS_DTC=y
BR2_TARGET_UBOOT_FORMAT_IMX=y
BR2_PACKAGE_HOST_MTOOLS=y
```
